#include <SPI.h>
#include <Wire.h>
#include <avr/pgmspace.h>

const int SlaveSelectPin = 3;
const int ChipEnable= 4;
const int AmpRead= A7;
const int PhaRead= A6;
const int pin_a = 6;        // A >pin6, A high, 2 switch on
const int pin_b = 5;        // B >pin5, B high, 1 switch on 
int Amp_val=0;
int Pha_val=0;
void initialize(unsigned long R[]);
void data_trans();
void Sweep();
unsigned long Reg[6];
const uint32_t R_0 [2201] PROGMEM={0x640000,0x640010,0x640020,0x648008,0x648018,0x650000,0x650010,0x650020,0x658008,0x658018,0x660000,0x660010,0x660020,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0x430098,0x438000};
const uint32_t R_1 [2201] PROGMEM={0x8008011,0x8008029,0x8008029,0x8008029,0x8008029,0x8008011,0x8008029,0x8008029,0x8008029,0x8008029,0x8008011,0x8008029,0x8008029,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0x80080a1,0x8008011};
const long R_2=0x14E42;
const long R_3=0x4B3; 
//+5 dBm output 
//const uint32_t R_4 [2201] PROGMEM={0xba003c,0xba003c,0xba003c,0xba003c,0xba003c,0xba003c,0xba003c,0xba003c,0xba003c,0xba003c,0xba003c,0xba003c,0xba003c,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0x8a003c,0x8a003c};
//-4 dBm output
const uint32_t R_4 [2201]PROGMEM={0xba0024,0xba0024,0xba0024,0xba0024,0xba0024,0xba0024,0xba0024,0xba0024,0xba0024,0xba0024,0xba0024,0xba0024,0xba0024,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0x8a0024,0x8a0024};
const long R_5=0x580005;
const uint32_t freq [2201] PROGMEM={500,501,502,503,504,505,506,507,508,509,510,511,512,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2699,2700};

void setup() {
  // put your setup code here, to run once:
  analogReference(INTERNAL2V56);
  for(int i =0; i<10; i++)
  {
    int idel_a = analogRead(AmpRead);
    int idel_b = analogRead(PhaRead);
    }
  Serial.begin(115200);
  pinMode(SlaveSelectPin,OUTPUT);
  pinMode(ChipEnable,OUTPUT);
  pinMode(pin_a,OUTPUT);
  pinMode(pin_b,OUTPUT);
  digitalWrite(pin_a,LOW);
  digitalWrite(pin_b,LOW);
  digitalWrite(SlaveSelectPin,HIGH);
  digitalWrite(ChipEnable,HIGH);
  SPI.setDataMode(SPI_MODE0);
  SPI.setBitOrder(MSBFIRST);
  SPI.setClockDivider(SPI_CLOCK_DIV128);
  SPI.begin();
  delay(500);

  initialize(Reg);

}

void loop() {
  // put your main code here, to run repeatedly:
  //Sweep_2201(Reg);                                  //a full sweep with 1MHz resolution,for calibration only
  Sweep_221(Reg);
  //single_sweep(Reg);
 //initialize(Reg);
  delay(10);

}

void initialize(unsigned long R[])
{

  R[0]=(0x640000);
  R[1]=(0x8008011);
  R[2]=0x14E42;
  R[3]=0x4B3;
  R[4]=(0xba003c);
  R[5]=0x580005;
   
  data_trans();
  }

void data_trans()
{
 
  WriteADF2(5);
  delayMicroseconds(1000);
  WriteADF2(4);
  delayMicroseconds(1000);
  WriteADF2(3);
  delayMicroseconds(1000);
  WriteADF2(2);
  delayMicroseconds(1000);
  WriteADF2(1);
  delayMicroseconds(1000);
  WriteADF2(0);
  delayMicroseconds(1000);
  digitalWrite(SlaveSelectPin, HIGH);
  }

void WriteADF2(int idx)
{
  byte buf[4];
  for(int i=0; i<4;i++){
    buf[i]= (byte)(Reg[idx]>>(i*8));
  }
  WriteADF(buf[3],buf[2],buf[1],buf[0]);
  }

  int WriteADF(byte a1, byte a2, byte a3, byte a4)
{
  digitalWrite(SlaveSelectPin, LOW);
  delayMicroseconds(10);
  SPI.transfer(a1);
  SPI.transfer(a2);
  SPI.transfer(a3);
  SPI.transfer(a4);
  Toggle();
  }

int Toggle()
{
  digitalWrite(SlaveSelectPin, HIGH);
  delayMicroseconds(5);
  digitalWrite(SlaveSelectPin, LOW);
  }
  
void freq_counter(int idx)
{
  int amp_buf = 0;
  int pha_buf = 0;
  Serial.print(pgm_read_dword(&freq[idx]));
  Serial.print(',');
  for(int i=0;i<5;i++)
  {
    amp_buf = amp_buf + analogRead(AmpRead);
    pha_buf = pha_buf + analogRead(PhaRead);
    }
  Amp_val= amp_buf/5;
  Pha_val= pha_buf/5;
  Serial.print(Amp_val);
  Serial.print(',');
  Serial.print(Pha_val);
  Serial.print('\n');
  delayMicroseconds(5);
  }


void Sweep_2201(unsigned long R[])
{
 for(int i=0;i<=2200;i+=1)      //(500MHz-2700MHz)
 {
  R[0]=pgm_read_dword(&R_0[i]);
  R[1]=pgm_read_dword(&R_1[i]);
  R[2]=R_2;
  R[3]=R_3;
  R[4]=pgm_read_dword(&R_4[i]);
  R[5]=R_5;
  //Serial.print(R[0],HEX);
  data_trans();
  freq_counter(i);

  if(i<=500)
  {
    digitalWrite(pin_a,HIGH);
    digitalWrite(pin_b,LOW);
    }
  else
  {
    digitalWrite(pin_a,LOW);
    digitalWrite(pin_b,HIGH);
    }
  }
}

void Sweep_221(unsigned long R[])
{
 for(int i=0;i<=2201;i+=10)      //(500MHz-2700MHz)
 {
  R[0]=pgm_read_dword(&R_0[i]);
  R[1]=pgm_read_dword(&R_1[i]);
  R[2]=R_2;
  R[3]=R_3;
  R[4]=pgm_read_dword(&R_4[i]);
  R[5]=R_5;

  if(i<=500)
  {
    digitalWrite(pin_a,HIGH);
    digitalWrite(pin_b,LOW);
    }
  else
  {
    digitalWrite(pin_a,LOW);
    digitalWrite(pin_b,HIGH);
    }
  //Serial.print(R[0],HEX);
  data_trans();
  freq_counter(i);
  }
}

void single_sweep(unsigned long R[])
{
  R[0]=(0x640000);
  R[1]=(0x8008011);
  R[2]=0x14E42;
  R[3]=0x4B3;
  R[4]=(0xba003c);
  R[5]=0x580005;
   
  data_trans();
  }
